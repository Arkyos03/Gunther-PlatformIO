/*
 * Gunther.ino Arduino core - tone() / noTone()
 * Copyright (c) 2026 Arkyos03 for AIR ESIEA - MIT License (see LICENSE)
 *
 * Square wave on any pin, generated by toggling the pin from the TC1 interrupt.
 * Only one tone at a time (same as on classic Arduino boards).
 * Typical use with the on-board piezo:  tone(BUZZER, 4000, 200);
 */
#include "gunther_internal.h"

static volatile uint32_t s_tone_pin = NOT_A_PIN;
static volatile int32_t  s_toggles  = -1;          /* -1 = endless */
static volatile uint32_t *s_outtgl;
static uint32_t s_mask;
static bool s_tc_ready = false;

static void tc1_sync(void)
{
  while (TC1->COUNT16.SYNCBUSY.reg) { }
}

static void tone_tc_init(void)
{
  MCLK->APBAMASK.reg |= MCLK_APBAMASK_TC1;
  gunther_gclk_enable(TC1_GCLK_ID, GUNTHER_GCLK_48M);
  TC1->COUNT16.CTRLA.reg = TC_CTRLA_SWRST;
  tc1_sync();
  NVIC_SetPriority(TC1_IRQn, 3);
  s_tc_ready = true;
}

static void tone_stop_timer(void)
{
  TC1->COUNT16.CTRLA.reg &= ~TC_CTRLA_ENABLE;
  tc1_sync();
  TC1->COUNT16.INTENCLR.reg = TC_INTENCLR_MC0;
  NVIC_DisableIRQ(TC1_IRQn);
}

void tone(uint32_t pin, uint32_t frequency, uint32_t duration_ms)
{
  if (pin >= NUM_DIGITAL_PINS || frequency == 0) { noTone(pin); return; }
  if (!s_tc_ready) tone_tc_init();

  if (s_tone_pin != NOT_A_PIN && s_tone_pin != pin) noTone(s_tone_pin);
  tone_stop_timer();

  /* Choose the smallest prescaler that keeps the compare value in 16 bits */
  static const uint16_t div_val[] = { 1, 2, 4, 8, 16, 64, 256, 1024 };
  uint32_t toggle_hz = frequency * 2UL;
  uint32_t presc = 0, top = 0;
  for (presc = 0; presc < 8; presc++) {
    top = VARIANT_GCLK1_FREQ / div_val[presc] / toggle_hz;
    if (top <= 65536UL) break;
  }
  if (presc == 8) { presc = 7; top = 65536UL; }
  if (top < 2) top = 2;

  s_toggles = (duration_ms > 0) ? (int32_t)((uint64_t)toggle_hz * duration_ms / 1000ULL) : -1;

  pinMode(pin, OUTPUT);
  digitalWrite(pin, LOW);
  s_outtgl = &PORT->Group[g_pins[pin].port].OUTTGL.reg;
  s_mask   = 1UL << g_pins[pin].pin;
  s_tone_pin = pin;

  TC1->COUNT16.CTRLA.reg = TC_CTRLA_MODE_COUNT16 | TC_CTRLA_PRESCALER(presc);
  TC1->COUNT16.WAVE.reg  = TC_WAVE_WAVEGEN_MFRQ;
  TC1->COUNT16.COUNT.reg = 0;
  tc1_sync();
  TC1->COUNT16.CC[0].reg = (uint16_t)(top - 1UL);
  tc1_sync();
  TC1->COUNT16.INTFLAG.reg = TC_INTFLAG_MC0;
  TC1->COUNT16.INTENSET.reg = TC_INTENSET_MC0;
  NVIC_ClearPendingIRQ(TC1_IRQn);
  NVIC_EnableIRQ(TC1_IRQn);
  TC1->COUNT16.CTRLA.reg |= TC_CTRLA_ENABLE;
  tc1_sync();
}

void noTone(uint32_t pin)
{
  if (!s_tc_ready) return;
  if (pin != s_tone_pin && s_tone_pin != NOT_A_PIN && pin < NUM_DIGITAL_PINS) return;
  tone_stop_timer();
  if (s_tone_pin != NOT_A_PIN) digitalWrite(s_tone_pin, LOW);
  s_tone_pin = NOT_A_PIN;
}

void TC1_Handler(void)
{
  TC1->COUNT16.INTFLAG.reg = TC_INTFLAG_MC0;
  *s_outtgl = s_mask;
  if (s_toggles > 0) {
    if (--s_toggles == 0) {
      tone_stop_timer();
      PORT->Group[g_pins[s_tone_pin].port].OUTCLR.reg = s_mask;
      s_tone_pin = NOT_A_PIN;
    }
  }
}
